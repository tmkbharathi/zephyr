## boards/beagle/beaglebone_black/Kconfig.beaglebone_black
```kconfig
# Copyright (c) 2026 Manikanda Bharathi
# SPDX-License-Identifier: Apache-2.0

config BOARD_BEAGLEBONE_BLACK
	select SOC_AM3358 if BOARD_BEAGLEBONE_BLACK_AM3358
```

## boards/beagle/beaglebone_black/beaglebone_black_defconfig
```kconfig
CONFIG_SYS_CLOCK_HW_CYCLES_PER_SEC=1000000000

CONFIG_SERIAL=y
CONFIG_UART_INTERRUPT_DRIVEN=y
CONFIG_UART_NS16550=y
CONFIG_CONSOLE=y
CONFIG_UART_CONSOLE=y
```

## boards/beagle/beaglebone_black/board.yml
```yaml
board:
  name: beaglebone_black
  full_name: BeagleBone Black
  vendor: beagle
  socs:
  - name: am3358
```

## dts/bindings/interrupt-controller/ti,am335x-intc.yaml
```yaml
# Copyright (c) 2026 Manikanda Bharathi
# SPDX-License-Identifier: Apache-2.0

description: TI AM335x Interrupt Controller

compatible: "ti,am335x-intc"

include: [interrupt-controller.yaml, base.yaml]

properties:
  reg:
    required: true

interrupt-cells:
  - irq
  - priority
```

## soc/ti/Kconfig
```kconfig
# Copyright (c) 2026 Manikanda Bharathi
# SPDX-License-Identifier: Apache-2.0

rsource "am335x/Kconfig.soc"
```

## soc/ti/am335x/Kconfig
```kconfig
# Copyright (c) 2026 Manikanda Bharathi
# SPDX-License-Identifier: Apache-2.0

if SOC_FAMILY_TI_AM335X

config SOC_PART_NUMBER
	default "AM3358" if SOC_AM3358

endif # SOC_FAMILY_TI_AM335X
```

## soc/ti/am335x/Kconfig.defconfig
```kconfig
# Copyright (c) 2026 Manikanda Bharathi
# SPDX-License-Identifier: Apache-2.0

if SOC_SERIES_AM335X

config NUM_IRQS
	default 128

endif # SOC_SERIES_AM335X
```

## soc/ti/am335x/Kconfig.soc
```kconfig
# Copyright (c) 2026 Manikanda Bharathi
# SPDX-License-Identifier: Apache-2.0

config SOC_FAMILY_TI_AM335X
	bool

config SOC_FAMILY
	default "ti_am335x" if SOC_FAMILY_TI_AM335X

config SOC_SERIES_AM335X
	bool
	select SOC_FAMILY_TI_AM335X

config SOC_SERIES
	default "am335x" if SOC_SERIES_AM335X

config SOC_AM3358
	bool
	select SOC_SERIES_AM335X
	select CPU_CORTEX_A8
	select ARM
	select ARM_CUSTOM_INTERRUPT_CONTROLLER

config SOC
	default "am3358" if SOC_AM3358
```
